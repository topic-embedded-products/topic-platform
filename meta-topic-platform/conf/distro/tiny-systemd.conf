## meta-topic-platform/conf/distro/tiny-systemd.conf
```bitbake
# Tiny distribution, using systemd
# Intended for small flash systems

DISTRO_VERSION = "topic-tiny-systemd.0"

require topic-systemd-common.inc
```

## meta-topic-platform/conf/distro/tiny.conf
```bitbake
# Tiny distribution, using busybox for hotplug and login.
# Intended for small flash systems

DISTRO_VERSION = "topic-tiny.0"

# providers
PREFERRED_PROVIDER_libcrypto = "openssl"
PREFERRED_PROVIDER_libssl = "openssl"
PREFERRED_PROVIDER_jpeg = "libjpeg-turbo"
PREFERRED_PROVIDER_jpeg-native = "libjpeg-turbo-native"

VIRTUAL-RUNTIME_dev_manager = "busybox-mdev"
VIRTUAL-RUNTIME_login_manager = "busybox"
VIRTUAL-RUNTIME_init_manager = "${DISTRO_FEATURES_INITMAN}"
VIRTUAL-RUNTIME_initscripts = "initscripts"
# Avoid the "hwclock" script to be present in the filesystem.
# The kernel already takes care of the RTC and this script only
# breaks that functionality.
VIRTUAL-RUNTIME_base-utils-hwclock = ""

DISTRO_FEATURES_INITMAN = "sysvinit"
DISTRO_FEATURES_BACKFILL_CONSIDERED = "pulseaudio"
DISTRO_FEATURES = "ipv4 ipv6 usbgadget usbhost wifi bluetooth largefile ${DISTRO_FEATURES_LIBC}"

# don't run login on root console, messes with GUI
USE_VT = "0"
SYSVINIT_ENABLED_GETTYS = ""

# build some core libs with heavier compiler optimization
O3_OPT = "-O3 -pipe ${DEBUG_FLAGS}"
FULL_OPTIMIZATION:pn-libgcrypt = "${O3_OPT}"
FULL_OPTIMIZATION:pn-zlib = "${O3_OPT}"

# Allow licenses for gstreamer components (consult your legal department...)
LICENSE_FLAGS_ACCEPTED ?= "commercial"
COMMERCIAL_AUDIO_PLUGINS ?= "gst-plugins-ugly-mad gst-plugins-ugly-mpegaudioparse"
COMMERCIAL_VIDEO_PLUGINS ?= "gst-plugins-ugly-mpeg2dec gst-plugins-ugly-mpegstream gst-plugins-bad-mpegvideoparse"

# Package feed, defaults to build host's local (avahi) name
DISTRO_HOST_NAME ?= "${@os.uname()[1]}.local"
DISTRO_HOST_NAME_TOPICPLATFORM ?= "${DISTRO_HOST_NAME}"
DISTRO_FEED_NAME ?= "topic-platform"
DISTRO_FEED_PREFIX = "topic"
DISTRO_FEED_URI = "http://${DISTRO_HOST_NAME_TOPICPLATFORM}/${DISTRO_FEED_NAME}"
# Each machine should build its own package, otherwise all feeds will point
# to the sstate server.
DISTRO_HOST_NAME_TOPICPLATFORM[vardepvalue] = "${DISTRO_HOST_NAME_TOPICPLATFORM}"
```

## meta-topic-platform/conf/layer.conf
```bitbake
# We have a conf directory, append to BBPATH
BBPATH .= ":${LAYERDIR}"

# We have a recipes directory, add to BBFILES
BBFILES += "${LAYERDIR}/recipes-*/*/*.bb ${LAYERDIR}/recipes-*/*/*.bbappend"

BBFILE_COLLECTIONS += "topic-platform-layer"
BBFILE_PATTERN_topic-platform-layer := "^${LAYERDIR}/"

LAYERDEPENDS_topic-platform-layer = "core swupdate"
LAYERSERIES_COMPAT_topic-platform-layer = "mickledore"
```

## scripts/templates/build/conf/bblayers.conf
```bitbake
# LAYER_CONF_VERSION is increased each time build/conf/bblayers.conf
# changes incompatibly
LCONF_VERSION = "7"

# Top dir is three dirs up
LAYERTOPDIR := "${@os.path.dirname(os.path.dirname(os.path.dirname(d.getVar('FILE', True))))}"

BBPATH = "${TOPDIR}"
BBFILES ?= ""

BBLAYERS = " \
  ${LAYERTOPDIR}/oe-core/meta \
  ${LAYERTOPDIR}/meta-oe/meta-oe \
  ${LAYERTOPDIR}/meta-oe/meta-python \
  ${LAYERTOPDIR}/meta-oe/meta-networking \
  ${LAYERTOPDIR}/meta-oe/meta-filesystems \
  ${LAYERTOPDIR}/meta-oe/meta-multimedia \
  ${LAYERTOPDIR}/meta-arm/meta-arm-toolchain \
  ${LAYERTOPDIR}/meta-arm/meta-arm \
  ${LAYERTOPDIR}/meta-xilinx/meta-microblaze \
  ${LAYERTOPDIR}/meta-xilinx/meta-xilinx-core \
  ${LAYERTOPDIR}/meta-xilinx/meta-xilinx-standalone \
  ${LAYERTOPDIR}/meta-xilinx/meta-xilinx-bsp \
  ${LAYERTOPDIR}/meta-xilinx-tools \
  ${LAYERTOPDIR}/meta-swupdate \
  ${LAYERTOPDIR}/meta-topic \
  ${LAYERTOPDIR}/meta-topic-platform \
  "
```
